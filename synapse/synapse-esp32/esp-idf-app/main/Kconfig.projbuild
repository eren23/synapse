## synapse/synapse-esp32/esp-idf-app/main/Kconfig.projbuild
```kconfig
menu "Synapse LEWM Config"
    config LEWM_WIFI_SSID
        string "WiFi SSID"
        default "myssid"
    config LEWM_WIFI_PASS
        string "WiFi Password"
        default "mypassword"
endmenu
```

## synapse/synapse-esp32/esp-idf-app/sdkconfig.defaults
```kconfig
# Enable experimental features (required for PSRAM 200MHz)
CONFIG_IDF_EXPERIMENTAL_FEATURES=y

# Flash size (32MB NOR flash on Waveshare ESP32-P4)
CONFIG_ESPTOOLPY_FLASHSIZE_32MB=y

# PSRAM (32MB on Waveshare ESP32-P4)
CONFIG_SPIRAM=y
# Must explicitly unset 20M for the choice to pick 200M
CONFIG_SPIRAM_SPEED_20M=n
CONFIG_SPIRAM_SPEED_200M=y

# Custom partition table (16MB factory for embedded model)
CONFIG_PARTITION_TABLE_CUSTOM=y
CONFIG_PARTITION_TABLE_CUSTOM_FILENAME="partitions.csv"

# WiFi via esp_hosted + esp_wifi_remote (C6 companion over SDIO)
# Do NOT set CONFIG_ESP_HOST_WIFI_ENABLED -- that's for chips with native WiFi
CONFIG_ESP_WIFI_REMOTE_LIBRARY_HOSTED=y
CONFIG_SLAVE_IDF_TARGET_ESP32C6=y

# HTTP server tuning
CONFIG_HTTPD_MAX_REQ_HDR_LEN=1024
CONFIG_HTTPD_MAX_URI_LEN=512

# Compiler: optimize for performance instead of debug (-O2 vs -Og)
CONFIG_COMPILER_OPTIMIZATION_PERF=y

# Increase main task stack (encoder with -O2 inlining needs more)
CONFIG_ESP_MAIN_TASK_STACK_SIZE=16384

# Larger TCP buffers for image upload (602KB binary)
CONFIG_LWIP_TCP_SND_BUF_DEFAULT=32768
CONFIG_LWIP_TCP_WND_DEFAULT=32768

# WiFi credentials (set via menuconfig or override here)
CONFIG_LEWM_WIFI_SSID="FiberHGW_ZY1B56"
CONFIG_LEWM_WIFI_PASS="YvtHq3vPAX9U"
```

## synapse/synapse-esp32/esp-idf-app/sdkconfig.defaults.esp32p4
```kconfig
# ESP32-P4 Waveshare board with on-board ESP32-C6 over SDIO.
# These options come from the esp_hosted P4 Function EV board guidance and
# must be target-scoped so ESP-IDF applies them after the P4 target is known.
CONFIG_SLAVE_IDF_TARGET_ESP32C6=y
CONFIG_ESP_HOSTED_CP_TARGET_ESP32C6=y
CONFIG_ESP_HOSTED_P4_DEV_BOARD_FUNC_BOARD=y
CONFIG_ESP_HOSTED_SDIO_HOST_INTERFACE=y

# esp_wifi_remote injects WIFI_INIT_CONFIG_DEFAULT() fields from these values.
CONFIG_WIFI_RMT_STATIC_RX_BUFFER_NUM=16
CONFIG_WIFI_RMT_DYNAMIC_RX_BUFFER_NUM=64
CONFIG_WIFI_RMT_DYNAMIC_TX_BUFFER=y
CONFIG_WIFI_RMT_DYNAMIC_TX_BUFFER_NUM=64
CONFIG_WIFI_RMT_TX_BUFFER_TYPE=1
CONFIG_WIFI_RMT_STATIC_RX_MGMT_BUFFER=y
CONFIG_WIFI_RMT_DYNAMIC_RX_MGMT_BUF=0
CONFIG_WIFI_RMT_ESPNOW_MAX_ENCRYPT_NUM=7
CONFIG_WIFI_RMT_AMPDU_TX_ENABLED=y
CONFIG_WIFI_RMT_TX_BA_WIN=32
CONFIG_WIFI_RMT_AMPDU_RX_ENABLED=y
CONFIG_WIFI_RMT_RX_BA_WIN=32

# Match the hosted board docs for larger network buffers on this transport.
CONFIG_LWIP_TCP_SND_BUF_DEFAULT=65534
CONFIG_LWIP_TCP_WND_DEFAULT=65534
CONFIG_LWIP_TCP_RECVMBOX_SIZE=64
CONFIG_LWIP_UDP_RECVMBOX_SIZE=64
CONFIG_LWIP_TCPIP_RECVMBOX_SIZE=64
CONFIG_LWIP_TCP_SACK_OUT=y
```

## synapse/synapse-esp32/sdkconfig.defaults
```kconfig
# ESP32-P4 SDK configuration for synapse inference
# Board: Waveshare ESP32-P4-WiFi6, 32MB PSRAM, 32MB flash

# --- PSRAM (32MB OPI @ 200MHz) ---
CONFIG_SPIRAM=y
CONFIG_SPIRAM_MODE_OCT=y
CONFIG_SPIRAM_SPEED_200M=y
CONFIG_SPIRAM_USE_MALLOC=y
CONFIG_SPIRAM_MALLOC_ALWAYSINTERNAL=4096

# --- Memory ---
CONFIG_ESP_MAIN_TASK_STACK_SIZE=16384

# --- Newlib ---
CONFIG_NEWLIB_NANO_FORMAT=y

# --- Logging (set to INFO for production, DEBUG for development) ---
CONFIG_ESP_SYSTEM_PANIC_PRINT_REBOOT=y
CONFIG_LOG_DEFAULT_LEVEL_INFO=y
CONFIG_LOG_MAXIMUM_LEVEL_DEBUG=y
```
